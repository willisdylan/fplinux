## platforms/ums9117/linux/overlay/Documentation/devicetree/bindings/soc/fplinux,ums9117-f286-radio.yaml
```yaml
# SPDX-License-Identifier: GPL-2.0-only
%YAML 1.2
---
$id: http://devicetree.org/schemas/soc/fplinux,ums9117-f286-radio.yaml#
$schema: http://devicetree.org/meta-schemas/core.yaml#

title: Ruio F286 baseband power-on and DSP bring-up

maintainers:
  - FPLinux contributors <313246064+fplinux-dev@users.noreply.github.com>

description: |
  Research driver for the Ruio F286 (UMS9117) baseband. It powers on the
  whale die and loads and releases the GSM and LTE DSPs in the order the
  stock firmware uses, one step per sysfs attribute. The node has no reg:
  the driver maps the fixed AON, PMU and DSP windows itself, like the rest
  of the F286 support. Nothing touches hardware until an attribute is
  written.

properties:
  compatible:
    const: fplinux,ums9117-f286-radio

  firmware-name:
    items:
      - description: LTE DSP image
      - description: GSM DSP image

required:
  - compatible
  - firmware-name

additionalProperties: false

examples:
  - |
    radio {
        compatible = "fplinux,ums9117-f286-radio";
        firmware-name = "ums9117/f286-lte-dsp.bin",
                        "ums9117/f286-gsm-dsp.bin";
    };
```

## platforms/ums9117/linux/overlay/drivers/soc/ums9117/Kconfig
```kconfig
# SPDX-License-Identifier: GPL-2.0-only
config F286_RADIO_UMS9117
	bool "Ruio F286 baseband radio and DSP bring-up"
	depends on ARCH_UMS9117
	help
	  Bring-up driver for the Ruio F286 baseband: the stock whale-die
	  power-on sequence (AON gate sets, keyed 0x40310008 step-0,
	  analog-die ADI batch, radio-on set) and the GSM/LTE DSP boot
	  sequences (firmware copies into the DSP DRAM region below the Linux
	  memory base, boot address, start control, reset release, command
	  queue poll), driven from sysfs. Exposes radio_power, load_lte,
	  load_gsm, status and binary attributes for the DSP AP windows.
	  Touches no hardware until a user writes the attributes.

	  This is a research driver: the LTE DSP does not start yet and the
	  phone hangs about a second after load_lte. Say N unless you are
	  working on the F286 radio.
```

## targets/ruio-f286/linux/fragments/arch/arm/mach-ums9117/Kconfig
```kconfig
# SPDX-License-Identifier: GPL-2.0-only
if ARCH_UMS9117

config MACH_RUIO_F286
	bool "Ruio F286"
	select GPIOLIB
	select GPIO_PMIC_EIC_SPRD
	select MFD_SYSCON
	help
	  Board support for the Ruio F286 (UMS9117) feature phone, loaded
	  into RAM over USB. The board provides the USB session, read-only
	  internal NAND access, the GC9307 display and the keypad. Audio is
	  not supported; Bluetooth and the baseband radio are work in
	  progress.

endif
```
